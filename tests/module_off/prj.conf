## CMakeLists.txt
```
# Compile-only: does <embarch/outpost.h> still work in an image that does NOT
# have the outpost module compiled in?
#
# That is the shipping build of every application that instruments a hot path,
# and until 2026-08-27 the answer was no: `zephyr_include_directories(include)`
# sat below the CONFIG_EMBARCH_OUTPOST early return, so the header did not
# resolve at all and every OUTPOST_EVT() call site had to be wrapped in the
# application's own #ifdef. Nothing failed loudly — an app simply could not
# put a marker in shared library code.
cmake_minimum_required(VERSION 3.20.0)
find_package(Zephyr REQUIRED HINTS $ENV{ZEPHYR_BASE})
project(outpost_module_off LANGUAGES C)
target_sources(app PRIVATE src/main.c)
```

## prj.conf
```kconfig
# The whole point: the module is on the west manifest and NOT enabled.
CONFIG_EMBARCH_OUTPOST=n
```

## src/main.c
```c
/*
 * Copyright (c) 2026 Gabriel Tetar
 * SPDX-License-Identifier: MIT
 */

/* An application that traces in one build and ships in another, compiled here
 * in the shipping configuration. Both lines below must compile with
 * CONFIG_EMBARCH_OUTPOST unset:
 *
 *   - the include, because library code that carries a marker has no way to
 *     know which build it is in;
 *   - the call, because wrapping every site in #ifdef is precisely what the
 *     header's no-op tier exists to spare the application.
 *
 * The marker name is deliberately one no OUTPOST_MARKERS() list registers.
 * With the module off, no registration header was included, so no ID exists
 * to check against and the name is unchecked *here* — see the third tier in
 * outpost.h. The check is real in both builds that have the module, which is
 * every build where a marker has a reason to exist.
 */

#include <embarch/outpost.h>

#include <zephyr/kernel.h>

int main(void)
{
	OUTPOST_EVT(A_NAME_NOTHING_REGISTERED, 42);
	return 0;
}
```
