## CMakeLists.txt
```
cmake_minimum_required(VERSION 3.20.0)
find_package(Zephyr REQUIRED HINTS $ENV{ZEPHYR_BASE})
project(outpost_native_sim_stream)

# zephyr_include_directories(), not target_include_directories(app ...): the
# outpost module compiles the marker registration header too, and it is not
# part of the `app` target. Any consuming project needs this line.
zephyr_include_directories(src)

target_sources(app PRIVATE src/main.c)
```

## prj.conf
```kconfig
CONFIG_EMBARCH_OUTPOST=y
# Two symbols, not one: TRACING_USER is a Kconfig *choice* member, and neither
# `select` nor `configdefault` reaches one from a module (both were tried; both
# warn and do nothing). src/outpost.c refuses to compile without it, so the
# pair still cannot be half-enabled.
CONFIG_TRACING_USER=y
CONFIG_EMBARCH_OUTPOST_MARKER_HEADER="app_outpost_markers.h"

# Small ring on purpose: the burst in main() must actually overflow it, so the
# gap record is exercised rather than asserted.
CONFIG_EMBARCH_OUTPOST_RING_BYTES=1024
CONFIG_EMBARCH_OUTPOST_HEADER_INTERVAL_MS=100
CONFIG_EMBARCH_OUTPOST_THREAD_WAIT_MS=2

# native_sim has no serial driver by default -- its console is
# POSIX_ARCH_CONSOLE, which writes to stdout without a UART at all.
CONFIG_SERIAL=y
CONFIG_UART_CONSOLE=n

# uart0 bound to the process's own stdout, so `zephyr.exe > outpost.bin`
# captures the stream exactly as a serial capture would. Nothing else may write
# there: POSIX_ARCH_CONSOLE is y-selected by the board and cannot be turned
# off, so printk is what gets silenced instead.
CONFIG_UART_NATIVE_PTY_0_ON_STDINOUT=y
CONFIG_PRINTK=n
CONFIG_BOOT_BANNER=n
CONFIG_LOG=n
```

## app.overlay
```dts
/*
 * The board facts, declared in the consuming project — never in the module
 * (decisions.md decision 1). Here that is native_sim's PTY UART, which the
 * build binds to the process's own stdout.
 */
/ {
	chosen {
		embarch,outpost-uart = &uart0;
	};
};
```

## src/main.c
```c
/*
 * Copyright (c) 2026 Gabriel Tetar
 * SPDX-License-Identifier: MIT
 */

/*
 * End-to-end test: put real bytes through a real UART device and decode them
 * on the host. Phase C's definition of done, minus the hardware.
 *
 * The outpost UART is native_sim's PTY UART bound to stdout, and the Zephyr
 * console is off, so the process's stdout *is* the trace stream and
 * `zephyr.exe > outpost.bin` captures it exactly as a serial capture would.
 *
 * The workload deliberately produces every record kind the module can emit:
 * two named threads ping-ponging (switch in/out), a k_timer ISR (isr
 * enter/exit), sleeps (idle), markers, and a tight burst sized to overflow the
 * ring so a gap record is exercised rather than assumed.
 */

#include <embarch/outpost.h>

#include <zephyr/kernel.h>
#include <posix_board_if.h>

#define STACK 1024
#define PRIO  5

static K_SEM_DEFINE(ping, 1, 1);
static K_SEM_DEFINE(pong, 0, 1);

static void ping_fn(void *a, void *b, void *c)
{
	ARG_UNUSED(a);
	ARG_UNUSED(b);
	ARG_UNUSED(c);

	for (int i = 0; i < 200; i++) {
		k_sem_take(&ping, K_FOREVER);
		OUTPOST_EVT(WORK_BEGIN, i);
		k_busy_wait(50);
		OUTPOST_EVT(WORK_END, i);
		k_sem_give(&pong);
	}
}

static void pong_fn(void *a, void *b, void *c)
{
	ARG_UNUSED(a);
	ARG_UNUSED(b);
	ARG_UNUSED(c);

	for (int i = 0; i < 200; i++) {
		k_sem_take(&pong, K_FOREVER);
		k_sleep(K_MSEC(1));
		k_sem_give(&ping);
	}
}

K_THREAD_DEFINE(outpost_ping, STACK, ping_fn, NULL, NULL, NULL, PRIO, 0, 200);
K_THREAD_DEFINE(outpost_pong, STACK, pong_fn, NULL, NULL, NULL, PRIO, 0, 200);

static void tick(struct k_timer *t)
{
	ARG_UNUSED(t);
	/* Runs in the timer ISR: markers are legal from interrupt context. */
	OUTPOST_EVT(BURST, 0);
}

static K_TIMER_DEFINE(ticker, tick, NULL);

int main(void)
{
	k_timer_start(&ticker, K_MSEC(5), K_MSEC(5));

	/* Let the ping-pong and the timer run. */
	k_sleep(K_MSEC(400));

	/* Now overflow the ring on purpose: far more markers back to back than
	 * the drain thread can possibly clear, so the stream carries a real
	 * gap record rather than a hypothetical one.
	 */
	for (int i = 0; i < 20000; i++) {
		OUTPOST_EVT(BURST, i);
	}

	/* Let the drain thread clear the ring and report the gap. */
	k_sleep(K_MSEC(400));

	/* main() returning does not end a native_sim run — the drain thread is
	 * still alive and the process would idle forever. Exit explicitly so
	 * the capture is a finite file with a defined end.
	 */
	posix_exit(0);
	return 0;
}
```

## src/app_outpost_markers.h
```c
/* This application's marker registration list — the whole of §5.2's third
 * step, in a consuming repo rather than in the module.
 */
#ifndef APP_OUTPOST_MARKERS_H_
#define APP_OUTPOST_MARKERS_H_

#define OUTPOST_MARKERS(X)                                                                         \
	X(WORK_BEGIN)                                                                              \
	X(WORK_END)                                                                                \
	X(BURST)

#endif /* APP_OUTPOST_MARKERS_H_ */
```
